#ifndef ZMKCFG_HELPERS_DTSI
#define ZMKCFG_HELPERS_DTSI

// -- ZMK helpers --------------------------------------------------------------

#define ZMK_HOLD_TAP(name, ...) \
    name { \
        compatible = "zmk,behavior-hold-tap"; \
        #binding-cells = <2>; \
        __VA_ARGS__ \
    };

#define ZMK_MOD_MORPH(name, ...) \
    name { \
        compatible = "zmk,behavior-mod-morph"; \
        #binding-cells = <0>; \
        __VA_ARGS__ \
    };

#define ZMK_STICKY_KEY(name, ...) \
    name { \
        compatible = "zmk,behavior-sticky-key"; \
        #binding-cells = <1>; \
        __VA_ARGS__ \
    };

#define ZMK_COMBO(name, ...) \
    name { \
        __VA_ARGS__ \
    };

#define ZMK_COMBOS(...) \
    combos { \
        compatible = "zmk,combos"; \
        __VA_ARGS__ \
    };

#define ZMK_CONDITIONAL_LAYER(name, ...) \
    name { \
        __VA_ARGS__ \
    };

#define ZMK_CONDITIONAL_LAYERS(...) \
    conditional_layers { \
        compatible = "zmk,conditional-layers"; \
        __VA_ARGS__ \
    };

#define ZMK_MACRO_NO_PARAM(name, ...) \
    name { \
        compatible = "zmk,behavior-macro"; \
        #binding-cells = <0>; \
        __VA_ARGS__ \
    };

#define ZMK_MACRO_ONE_PARAM(name, ...) \
    name { \
        compatible = "zmk,behavior-macro-one-param"; \
        #binding-cells = <1>; \
        __VA_ARGS__ \
    };

#define ZMK_KEYMAPS(...) \
    keymap { \
        compatible = "zmk,keymap"; \
        __VA_ARGS__ \
    };

#define ZMK_LAYER(layer_name, display_name, bindings_value) \
    layer_name { \
        display-name = display_name; \
        bindings = bindings_value; \
    };

#define ZMK_RESERVED_LAYER(layer_name, display_name) \
    layer_name { \
        display-name = display_name; \
        status = "reserved"; \
    };

// -- Defaults -----------------------------------------------------------------

#define HOLD_TAP(name, HOLD, TAP, ...) \
    ZMK_HOLD_TAP(name, \
        bindings = HOLD, TAP; \
        flavor = "balanced"; \
        tapping-term-ms = <HOLD_MS>; \
        __VA_ARGS__ \
    )

#define HOLD_TAP_QUICK_TAP(name, HOLD, TAP) \
    HOLD_TAP(name, HOLD, TAP, \
        quick-tap-ms = <QUICK_TAP_MS>; \
    )

#define MOD_MORPH(name, TAP, MORPHED_TAP, MODS, ...) \
    ZMK_MOD_MORPH(name, \
        bindings = TAP, MORPHED_TAP; \
        mods = MODS; \
        __VA_ARGS__ \
    )

#define SHIFT_MORPH(name, TAP, MORPHED_TAP) \
    MOD_MORPH(name, TAP, MORPHED_TAP, <(MOD_LSFT | MOD_RSFT)>)

#define STICKY_KEY(name, TAP, ...) \
    ZMK_STICKY_KEY(name, \
        bindings = TAP; \
        release-after-ms = <RELEASE_AFTER_MS>; \
        __VA_ARGS__ \
    )

#define STICKY_KEY_QUICK_RELEASE(name, TAP) \
    STICKY_KEY(name, TAP, \
        quick-release; \
    )

#define COMBO(name, KEY_POSITIONS, DISPATCH) \
    ZMK_COMBO(name, \
        key-positions = KEY_POSITIONS; \
        bindings = DISPATCH; \
        timeout-ms = <COMBO_TIMEOUT_MS>; \
        require-prior-idle-ms = <PRIOR_IDLE_MS>; \
    )

#define CONDITIONAL_LAYER(name, IF_LAYERS, THEN_LAYERS) \
    ZMK_CONDITIONAL_LAYER(name, \
        if-layers = IF_LAYERS; \
        then-layer = THEN_LAYERS; \
    )

#define MACRO_NO_PARAM(name, ...) \
    ZMK_MACRO_NO_PARAM(name, \
        bindings = __VA_ARGS__; \
    )

#define MACRO_ONE_PARAM(name, ...) \
    ZMK_MACRO_ONE_PARAM(name, \
        bindings = <&macro_param_1to1>, __VA_ARGS__; \
    )

// -- Presets ------------------------------------------------------------------

#define MACRO_BRACKET_PAIR(name, OPEN_KEY, CLOSE_KEY) \
    MACRO_NO_PARAM(name, <&kp OPEN_KEY &kp CLOSE_KEY &kp LEFT>)

#define MACRO_ARROW_R(name, SYMBOL_KEY) \
    MACRO_NO_PARAM(name, <&kp SYMBOL_KEY &kp GREATER_THAN &kp SPACE>)

#define MACRO_ARROW_L(name, SYMBOL_KEY) \
    MACRO_NO_PARAM(name, <&kp LESS_THAN &kp SYMBOL_KEY &kp SPACE>)

// ZMKCFG_HELPERS_DTSI
#endif
